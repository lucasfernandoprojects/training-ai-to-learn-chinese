#include <Adafruit_GFX.h>
#include <Adafruit_ST7789.h>
#include <SPI.h>
#include <avr/pgmspace.h>

// Display pins
#define TFT_CS   10
#define TFT_RST  9
#define TFT_DC   8
#define TFT_BL   7

// Other components
#define GREEN_LED 4
#define RED_LED   5
#define BUTTON_PIN 6      // Main action button
#define UP_BUTTON 3       // Up navigation button
#define DOWN_BUTTON 2     // Down navigation button

// Menu display constants
#define MAX_VISIBLE_ITEMS 6  // Number of items visible on screen at once
#define ITEM_HEIGHT 25       // Height of each menu item
#define MENU_TOP_POS 60      // Y-position where menu items start

Adafruit_ST7789 tft = Adafruit_ST7789(TFT_CS, TFT_DC, TFT_RST);

// Character bitmaps
// 'ban', 72x120px
const unsigned char epd_bitmap_ban [] PROGMEM = {
  0x00, 0x00, 0x00, 0x00, 0x00, 0x00, 0x00, 0x00, 0x00, 0x00, 0x00, 0x00, 0x00, 0x00, 0x00, 0x00, 
  0x00, 0x00, 0x00, 0x00, 0x00, 0x00, 0x7e, 0x00, 0x00, 0x00, 0x00, 0x00, 0x00, 0x00, 0x00, 0x7e, 
  0x00, 0x00, 0x00, 0x00, 0x00, 0x03, 0x00, 0x00, 0x7e, 0x00, 0x01, 0xe0, 0x00, 0x00, 0x1f, 0x80, 
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  0x00, 0x00, 0x00, 0x00, 0x00, 0x00, 0x00, 0x00
};
// 'cong', 72x120px
const unsigned char epd_bitmap_cong [] PROGMEM = {
  0x00, 0x00, 0x00, 0x00, 0x00, 0x00, 0x00, 0x00, 0x00, 0x00, 0x00, 0x00, 0x00, 0x00, 0x00, 0x00, 
  0x00, 0x00, 0x00, 0x00, 0x00, 0x00, 0x00, 0x00, 0x00, 0x00, 0x00, 0x00, 0x00, 0x10, 0x00, 0x00, 
  0x01, 0xc0, 0x00, 0x00, 0x00, 0x00, 0x1f, 0x80, 0x00, 0x03, 0xf0, 0x00, 0x00, 0x00, 0x00, 0x1f, 
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  0x00, 0x00, 0x00, 0x00, 0x00, 0x00, 0x00, 0x00
};
// 'er', 72x120px
const unsigned char epd_bitmap_er [] PROGMEM = {
  0x00, 0x00, 0x00, 0x00, 0x00, 0x00, 0x00, 0x00, 0x00, 0x00, 0x00, 0x00, 0x00, 0x00, 0x00, 0x00, 
  0x00, 0x00, 0x00, 0x00, 0x00, 0x00, 0x00, 0x00, 0x00, 0x00, 0x00, 0x00, 0x00, 0x00, 0x00, 0x00, 
  0x00, 0x00, 0x00, 0x00, 0x00, 0x00, 0x00, 0x00, 0x00, 0x00, 0x00, 0x00, 0x00, 0x00, 0x00, 0x00, 
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  0x00, 0x00, 0x00, 0x00, 0x00, 0x00, 0x00, 0x00
};
// 'gan', 72x120px
const unsigned char epd_bitmap_gan [] PROGMEM = {
  0x00, 0x00, 0x00, 0x00, 0x00, 0x00, 0x00, 0x00, 0x00, 0x00, 0x00, 0x00, 0x00, 0x00, 0x00, 0x00, 
  0x00, 0x00, 0x00, 0x00, 0x00, 0x00, 0x00, 0x00, 0x00, 0x00, 0x00, 0x00, 0x00, 0x00, 0x00, 0x00, 
  0x00, 0x00, 0x00, 0x00, 0x00, 0x00, 0x00, 0x00, 0x00, 0x00, 0x00, 0x00, 0x00, 0x00, 0x00, 0x00, 
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  0x00, 0x00, 0x00, 0x00, 0x00, 0x00, 0x00, 0x00
};
// 'ge', 72x120px
const unsigned char epd_bitmap_ge [] PROGMEM = {
  0x00, 0x00, 0x00, 0x00, 0x00, 0x00, 0x00, 0x00, 0x00, 0x00, 0x00, 0x00, 0x00, 0x00, 0x00, 0x00, 
  0x00, 0x00, 0x00, 0x00, 0x00, 0x00, 0x0c, 0x00, 0x00, 0x00, 0x00, 0x00, 0x00, 0x00, 0x00, 0x1f, 
  0x00, 0x00, 0x00, 0x00, 0x00, 0x00, 0x00, 0x00, 0x1f, 0x80, 0x00, 0x00, 0x00, 0x00, 0x00, 0x00, 
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  0x00, 0x00, 0x00, 0x00, 0x00, 0x00, 0x00, 0x00
};
// 'ren', 72x120px
const unsigned char epd_bitmap_ren [] PROGMEM = {
  0x00, 0x00, 0x00, 0x00, 0x00, 0x00, 0x00, 0x00, 0x00, 0x00, 0x00, 0x00, 0x00, 0x00, 0x00, 0x00, 
  0x00, 0x00, 0x00, 0x00, 0x00, 0x00, 0x7e, 0x00, 0x00, 0x00, 0x00, 0x00, 0x00, 0x00, 0x00, 0x7e, 
  0x00, 0x00, 0x00, 0x00, 0x00, 0x00, 0x00, 0x00, 0x7e, 0x00, 0x00, 0x00, 0x00, 0x00, 0x00, 0x00, 
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  0x00, 0x00, 0x00, 0x00, 0x00, 0x00, 0x00, 0x00
};
// 'ru', 72x120px
const unsigned char epd_bitmap_ru [] PROGMEM = {
  0x00, 0x00, 0x00, 0x00, 0x00, 0x00, 0x00, 0x00, 0x00, 0x00, 0x00, 0x00, 0x00, 0x00, 0x00, 0x00, 
  0x00, 0x00, 0x00, 0x00, 0x00, 0x00, 0x00, 0x00, 0x00, 0x00, 0x00, 0x00, 0x00, 0x00, 0x00, 0x00, 
  0x00, 0x00, 0x00, 0x00, 0x00, 0x00, 0x00, 0xc0, 0x00, 0x00, 0x00, 0x00, 0x00, 0x00, 0x00, 0x01, 
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  0x00, 0x00, 0x00, 0x00, 0x00, 0x00, 0x00, 0x00
};
// 'san', 72x120px
const unsigned char epd_bitmap_san [] PROGMEM = {
  0x00, 0x00, 0x00, 0x00, 0x00, 0x00, 0x00, 0x00, 0x00, 0x00, 0x00, 0x00, 0x00, 0x00, 0x00, 0x00, 
  0x00, 0x00, 0x00, 0x00, 0x00, 0x00, 0x00, 0x00, 0x00, 0x00, 0x00, 0x00, 0x00, 0x00, 0x00, 0x00, 
  0x00, 0x00, 0x00, 0x00, 0x00, 0x00, 0x00, 0x00, 0x00, 0x00, 0x00, 0x00, 0x00, 0x00, 0x00, 0x00, 
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  0x00, 0x00, 0x00, 0x00, 0x00, 0x00, 0x00, 0x00
};
// 'shi', 72x120px
const unsigned char epd_bitmap_shi [] PROGMEM = {
  0x00, 0x00, 0x00, 0x00, 0x00, 0x00, 0x00, 0x00, 0x00, 0x00, 0x00, 0x00, 0x00, 0x00, 0x00, 0x00, 
  0x00, 0x00, 0x00, 0x00, 0x00, 0x00, 0x7e, 0x00, 0x00, 0x00, 0x00, 0x00, 0x00, 0x00, 0x00, 0x7e, 
  0x00, 0x00, 0x00, 0x00, 0x00, 0x00, 0x00, 0x00, 0x7e, 0x00, 0x00, 0x00, 0x00, 0x00, 0x00, 0x00, 
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  0x00, 0x00, 0x00, 0x00, 0x00, 0x00, 0x00, 0x00
};
// 'yi', 72x120px
const unsigned char epd_bitmap_yi [] PROGMEM = {
  0x00, 0x00, 0x00, 0x00, 0x00, 0x00, 0x00, 0x00, 0x00, 0x00, 0x00, 0x00, 0x00, 0x00, 0x00, 0x00, 
  0x00, 0x00, 0x00, 0x00, 0x00, 0x00, 0x00, 0x00, 0x00, 0x00, 0x00, 0x00, 0x00, 0x00, 0x00, 0x00, 
  0x00, 0x00, 0x00, 0x00, 0x00, 0x00, 0x00, 0x00, 0x00, 0x00, 0x00, 0x00, 0x00, 0x00, 0x00, 0x00, 
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  0x00, 0x00, 0x00, 0x00, 0x00, 0x00, 0x00, 0x00
};

// Character info structure
struct CharacterInfo {
  const char* name;
  const unsigned char* bitmap;
  int width;
  int height;
  const char* pinyin;
  const char* meaning;
};

// Character database
const CharacterInfo characters[] = {
  {"ban_4", epd_bitmap_ban, 72, 120, "ban", "half"},
  {"cong_2", epd_bitmap_cong, 72, 120, "cong", "from"},
  {"er_4", epd_bitmap_er, 72, 120, "er", "two"},
  {"gan_1", epd_bitmap_gan, 72, 120, "gan", "dry"},
  {"ge_4", epd_bitmap_ge, 72, 120, "ge", "individual"},
  {"ren_2", epd_bitmap_ren, 72, 120, "ren", "person"},
  {"ru_4", epd_bitmap_ru, 72, 120, "ru", "to enter"},
  {"san_1", epd_bitmap_san, 72, 120, "san", "three"},
  {"shi_2", epd_bitmap_shi, 72, 120, "shi", "ten"},
  {"yi_1", epd_bitmap_yi, 72, 120, "yi", "one"}
};

// Menu system
enum SystemState {MAIN_MENU, WAITING_PHOTO, SHOWING_RESULT, LEARNING_MENU, CHARACTER_VIEW, ABOUT_SCREEN};
SystemState currentState = MAIN_MENU;
unsigned long resultDisplayTime = 0;

// Menu items
const char* menuItems[] = {"Inference", "Learn", "About"};
const int menuSize = 3;
int currentSelection = 0;

// Learning mode variables
const int charactersCount = sizeof(characters) / sizeof(characters[0]);
int learnSelection = 0;
int firstVisibleItem = 0;    // Index of first visible item
int lastVisibleItem = MAX_VISIBLE_ITEMS - 1; // Index of last visible item

void setup() {
  pinMode(GREEN_LED, OUTPUT);
  pinMode(RED_LED, OUTPUT);
  pinMode(BUTTON_PIN, INPUT_PULLUP);
  pinMode(UP_BUTTON, INPUT_PULLUP);
  pinMode(DOWN_BUTTON, INPUT_PULLUP);
  pinMode(TFT_BL, OUTPUT);
  digitalWrite(TFT_BL, HIGH);

  tft.init(135, 240);
  tft.setRotation(2);
  tft.fillScreen(ST77XX_BLACK);
  
  Serial.begin(9600);
  
  showWelcomeScreen();
  delay(2000);
  showMainMenu();
}

void loop() {
  switch(currentState) {
    case MAIN_MENU:
      handleMainMenu();
      break;
    case WAITING_PHOTO:
      handleWaitingPhoto();
      break;
    case SHOWING_RESULT:
      handleShowingResult();
      break;
    case LEARNING_MENU:
      handleLearningMenu();
      break;
    case CHARACTER_VIEW:
      handleCharacterView();
      break;
    case ABOUT_SCREEN:
      handleAboutScreen();
      break;
  }
}

void handleMainMenu() {
  // Up button navigation
  if (buttonPressed(UP_BUTTON)) {
    currentSelection = max(currentSelection - 1, 0);
    showMainMenu();
    delay(150); // Debounce delay
  }
  
  // Down button navigation
  if (buttonPressed(DOWN_BUTTON)) {
    currentSelection = min(currentSelection + 1, menuSize - 1);
    showMainMenu();
    delay(150); // Debounce delay
  }

  // Main button press
  if (buttonPressed(BUTTON_PIN)) {
    if (menuItems[currentSelection] == "Inference") {
      startInferenceMode();
    } else if (menuItems[currentSelection] == "Learn") {
      startLearningMenu();
    } else if (menuItems[currentSelection] == "About") {
      showAboutScreen();
    }
  }
}

void handleLearningMenu() {
  // Up button navigation
  if (buttonPressed(UP_BUTTON)) {
    learnSelection = max(learnSelection - 1, 0);
    showLearningMenu();
    delay(150); // Debounce delay
  }
  
  // Down button navigation
  if (buttonPressed(DOWN_BUTTON)) {
    learnSelection = min(learnSelection + 1, charactersCount);
    showLearningMenu();
    delay(150); // Debounce delay
  }

  // Main button press
  if (buttonPressed(BUTTON_PIN)) {
    if (learnSelection == charactersCount) {
      returnToMainMenu();
    } else {
      showCharacterView();
    }
  }
}

void handleCharacterView() {
  // Button press to return to learning menu
  if (buttonPressed(BUTTON_PIN)) {
    showLearningMenu();
  }
}

void handleAboutScreen() {
  // Button press to return to main menu
  if (buttonPressed(BUTTON_PIN)) {
    showMainMenu();
  }
}

void handleWaitingPhoto() {
  // Check for return to main menu (DOWN_BUTTON)
  if (buttonPressed(DOWN_BUTTON)) {
    returnToMainMenu();
    return;
  }

  // Main button press for capture
  if (buttonPressed(BUTTON_PIN)) {
    Serial.println("CAPTURE");
    digitalWrite(RED_LED, LOW);
  }

  if (Serial.available()) {
    String result = Serial.readStringUntil('\n');
    result.trim();
    if (result.startsWith("RESULT:")) {
      showResultScreen(result.substring(7));
    }
  }
}

void handleShowingResult() {
  // Automatically return to photo mode after 5 seconds
  if (millis() - resultDisplayTime >= 5000) {
    returnToPhotoMode();
  }
}

bool buttonPressed(int pin) {
  static unsigned long lastPress = 0;
  if (digitalRead(pin) == LOW && millis() - lastPress > 300) {
    lastPress = millis();
    return true;
  }
  return false;
}

void showWelcomeScreen() {
  tft.fillScreen(ST77XX_BLACK);
  tft.setTextColor(ST77XX_WHITE);
  tft.setTextSize(2);
  tft.setCursor(10, 70);
  tft.println("Mandarin");
  tft.setCursor(10, 100);
  tft.println("Character");
  tft.setCursor(10, 130);
  tft.println("Recognizer");
}

void showMainMenu() {
  currentState = MAIN_MENU;
  digitalWrite(RED_LED, LOW);
  digitalWrite(GREEN_LED, LOW);
  
  tft.fillScreen(ST77XX_BLACK);
  tft.setTextColor(ST77XX_WHITE);
  tft.setTextSize(2);
  tft.setCursor(45, 20);
  tft.println("Menu");

  for (int i = 0; i < menuSize; i++) {
    tft.setCursor(10, 70 + i * 30);
    if (i == currentSelection) tft.setTextColor(ST77XX_RED);
    else tft.setTextColor(ST77XX_WHITE);
    tft.println(menuItems[i]);
  }
}

void showAboutScreen() {
  currentState = ABOUT_SCREEN;
  
  tft.fillScreen(ST77XX_BLACK);
  tft.setTextColor(ST77XX_WHITE);
  tft.setTextSize(1);
  tft.setCursor(0, 10);
  tft.println("Created by Lucas");
  tft.setCursor(0, 20);
  tft.println("Fernando");
  tft.setCursor(0, 35);
  tft.println("Open source project");
  tft.setCursor(0, 45);
  tft.println("available on GitHub");
   tft.setCursor(0, 60);
  tft.print("Version: 1.0.0");
  tft.setCursor(0, 75);
  tft.println("For more projects like");
  tft.setCursor(0, 85);
  tft.println("this, visit my Youtube");
  tft.setCursor(0, 95);
  tft.println("channel");
  
  tft.setCursor(0, 230);
  tft.println("Press ENTER to return");
}

void startLearningMenu() {
  currentState = LEARNING_MENU;
  learnSelection = 0;
  firstVisibleItem = 0;
  lastVisibleItem = MAX_VISIBLE_ITEMS - 1;
  digitalWrite(RED_LED, LOW);
  digitalWrite(GREEN_LED, LOW);
  showLearningMenu();
}

void showLearningMenu() {
  currentState = LEARNING_MENU;
  
  tft.fillScreen(ST77XX_BLACK);
  tft.setTextColor(ST77XX_WHITE);
  tft.setTextSize(2);
  tft.setCursor(10, 20);
  tft.println("Characters");

  // Adjust visible items based on selection
  if (learnSelection < firstVisibleItem) {
    firstVisibleItem = learnSelection;
    lastVisibleItem = firstVisibleItem + MAX_VISIBLE_ITEMS - 1;
  } else if (learnSelection > lastVisibleItem) {
    lastVisibleItem = learnSelection;
    firstVisibleItem = lastVisibleItem - MAX_VISIBLE_ITEMS + 1;
  }

  // Ensure we don't go out of bounds
  lastVisibleItem = min(lastVisibleItem, charactersCount);
  firstVisibleItem = max(0, firstVisibleItem);

  // Display visible character list
  for (int i = firstVisibleItem; i <= lastVisibleItem; i++) {
    int displayIndex = i - firstVisibleItem;
    int yPos = MENU_TOP_POS + displayIndex * ITEM_HEIGHT;
    
    tft.setCursor(0, yPos);
    if (i == learnSelection) {
      tft.setTextColor(ST77XX_RED);
    } else {
      tft.setTextColor(ST77XX_WHITE);
    }
    
    // Print item number
    tft.print(i + 1);
    tft.print(". ");
    
    // Print character pinyin or "Go back"
    if (i < charactersCount) {
      tft.println(characters[i].pinyin);
    } else {
      tft.println("Go back");
    }
  }
}

void showCharacterView() {
  currentState = CHARACTER_VIEW;
  const CharacterInfo& character = characters[learnSelection];
  
  tft.fillScreen(ST77XX_BLACK);
  
  // Display character bitmap (centered)
  int charX = (tft.width() - character.width) / 2;
  int charY = 20;
  tft.drawBitmap(charX, charY, character.bitmap, character.width, character.height, ST77XX_WHITE);
  
  // Display instruction
  tft.setTextSize(1);
  tft.setTextColor(ST77XX_WHITE);
  tft.setCursor(0, tft.height() - 20);
  tft.println("Press ENTER to return");
}

void startInferenceMode() {
  currentState = WAITING_PHOTO;
  digitalWrite(RED_LED, HIGH);
  digitalWrite(GREEN_LED, LOW);
  
  tft.fillScreen(ST77XX_BLACK);
  tft.setTextColor(ST77XX_WHITE);
  tft.setTextSize(2);
  tft.setCursor(0, 80);
  tft.println("Waiting for");
  tft.setCursor(0, 110);
  tft.println("photo...");
  
  // Add instruction for returning
  tft.setTextSize(1);
  tft.setCursor(0, 230);
  tft.println("Press DOWN to return");
}

void showResultScreen(String className) {
  Serial.print("Processing result for: ");
  Serial.println(className);
  
  currentState = SHOWING_RESULT;
  resultDisplayTime = millis();
  digitalWrite(RED_LED, LOW);
  digitalWrite(GREEN_LED, HIGH);
  
  // Find character info
  const CharacterInfo* charInfo = nullptr;
  for (const auto& c : characters) {
    if (className.equals(c.name)) {
      charInfo = &c;
      break;
    }
  }

  if (!charInfo) {
    Serial.println("Character not found in database!");
    return;
  }

  tft.fillScreen(ST77XX_BLACK);
  
  // Display character bitmap
  int charX = (tft.width() - charInfo->width) / 2;
  int charY = 10;
  tft.drawBitmap(charX, charY, charInfo->bitmap, charInfo->width, charInfo->height, ST77XX_WHITE);
  
  // Display auto-return message
  tft.setTextSize(1);
  tft.setCursor(0, 230);
  tft.println("Loading photo mode...");
}

void returnToPhotoMode() {
  currentState = WAITING_PHOTO;
  digitalWrite(GREEN_LED, LOW);
  digitalWrite(RED_LED, HIGH);
  
  tft.fillScreen(ST77XX_BLACK);
  tft.setTextColor(ST77XX_WHITE);
  tft.setTextSize(2);
  tft.setCursor(0, 80);
  tft.println("Waiting for");
  tft.setCursor(0, 110);
  tft.println("photo...");
  
  // Add instruction for returning
  tft.setTextSize(1);
  tft.setCursor(0, 230);
  tft.println("Press DOWN to return");
}

void returnToMainMenu() {
  currentState = MAIN_MENU;
  digitalWrite(GREEN_LED, LOW);
  digitalWrite(RED_LED, LOW);
  showMainMenu();
}
